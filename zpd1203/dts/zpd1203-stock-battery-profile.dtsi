/*
 * Calibration cells from extracted/dts_src/boot_0.dts, /battery.
 * Keep the 5.10 mtk_gauge channel and NVMEM bindings.
 */
&mtk_gauge {
	DIFFERENCE_FULLOCV_ITH = <0xc8>;
	SHUTDOWN_1_TIME = <0x03>;
	KEEP_100_PERCENT = <0x01>;
	R_FG_VALUE = <0x05>;
	EMBEDDED_SEL = <0x01>;
	PMIC_SHUTDOWN_CURRENT = <0x14>;
	FG_METER_RESISTANCE = <0x64>;
	CAR_TUNE_VALUE = <0x61>;
	PMIC_MIN_VOL = <0x84d0>;
	POWERON_SYSTEM_IBOOT = <0x1f4>;
	SHUTDOWN_GAUGE0_VOLTAGE = <0x86c4>;
	TEMPERATURE_T0 = <0x32>;
	TEMPERATURE_T1 = <0x19>;
	TEMPERATURE_T2 = <0x0a>;
	TEMPERATURE_T3 = <0x00>;
	TEMPERATURE_T4 = <0xfffffff6>;
	g_FG_PSEUDO100_T0 = <0x64>;
	g_FG_PSEUDO100_T1 = <0x64>;
	g_FG_PSEUDO100_T2 = <0x64>;
	g_FG_PSEUDO100_T3 = <0x64>;
	g_FG_PSEUDO100_T4 = <0x64>;
	Q_MAX_SYS_VOLTAGE_BAT0 = <0xd48>;
	Q_MAX_SYS_VOLTAGE_BAT1 = <0xd48>;
	Q_MAX_SYS_VOLTAGE_BAT2 = <0xd48>;
	Q_MAX_SYS_VOLTAGE_BAT3 = <0xd48>;
	COM_FG_METER_RESISTANCE = <0x64>;
	COM_R_FG_VALUE = <0x00>;
	enable_tmp_intr_suspend = <0x00>;
	ACTIVE_TABLE = <0x05>;
	MULTI_TEMP_GAUGE0 = <0x01>;
	g_PMIC_MIN_VOL_row = <0x04>;
	g_PMIC_MIN_VOL_col = <0x0a>;
	g_PMIC_MIN_VOL = <
		0x8980 0x86c4 0x82dc 0x82dc 0x8980 0x86c4 0x82dc 0x82dc 0x8980 0x86c4 0x82dc 0x82dc
		0x7dc8 0x7dc8 0x7dc8 0x7dc8 0x7918 0x7918 0x7918 0x7918 0x7b0c 0x7b0c 0x7b0c 0x7b0c
		0x7918 0x7918 0x7918 0x7918 0x7918 0x7918 0x7918 0x7918 0x7918 0x7918 0x7918 0x7918
		0x7918 0x7918 0x7918 0x79e0
	>;
	g_PON_SYS_IBOOT_row = <0x04>;
	g_PON_SYS_IBOOT_col = <0x0a>;
	g_PON_SYS_IBOOT = <
		0x1388 0x1388 0x1388 0x1388 0x1388 0x1388 0x1388 0x1388 0x1388 0x1388 0x1388 0x1388
		0x1388 0x1388 0x1388 0x1388 0x1388 0x1388 0x1388 0x1388 0x1388 0x1388 0x1388 0x1388
		0x1388 0x1388 0x1388 0x1388 0x1388 0x1388 0x1388 0x1388 0x1388 0x1388 0x1388 0x1388
		0x1388 0x1388 0x1388 0x1388
	>;
	g_QMAX_SYS_VOL_row = <0x04>;
	g_QMAX_SYS_VOL_col = <0x0a>;
	g_QMAX_SYS_VOL = <
		0x8980 0x86c4 0x82dc 0x82dc 0x8980 0x86c4 0x82dc 0x82dc 0x8980 0x86c4 0x82dc 0x82dc
		0x8084 0x8084 0x8084 0x8084 0x8020 0x8020 0x8020 0x8020 0x82dc 0x82dc 0x82dc 0x82dc
		0x82dc 0x82dc 0x82dc 0x82dc 0x82dc 0x82dc 0x82dc 0x82dc 0x82dc 0x82dc 0x82dc 0x82dc
		0x82dc 0x82dc 0x82dc 0x82dc
	>;
	g_FG_PSEUDO100_row = <0x04>;
	g_FG_PSEUDO100_col = <0x0a>;
	g_FG_PSEUDO100 = <
		0x60 0x62 0x64 0x64 0x60 0x62 0x64 0x64 0x60 0x62 0x64 0x64
		0x60 0x62 0x64 0x64 0x60 0x62 0x64 0x64 0x60 0x62 0x64 0x64
		0x60 0x62 0x64 0x64 0x60 0x62 0x64 0x64 0x60 0x62 0x64 0x64
		0x60 0x62 0x64 0x64
	>;
	g_FG_charge_PSEUDO100_row = <0x04>;
	g_FG_charge_PSEUDO100_col = <0x0a>;
	g_FG_charge_PSEUDO100 = <
		0x60 0x62 0x64 0x64 0x60 0x62 0x64 0x64 0x60 0x62 0x64 0x64
		0x60 0x62 0x64 0x64 0x60 0x62 0x64 0x64 0x60 0x62 0x64 0x64
		0x60 0x62 0x64 0x64 0x60 0x62 0x64 0x64 0x60 0x62 0x64 0x64
		0x60 0x62 0x64 0x64
	>;
	battery0_profile_t0_num = <0x64>;
	battery0_profile_t0_col = <0x03>;
	battery0_profile_t0 = <
		0x00 0xa910 0x4c4 0x33c 0xa875 0x4c0 0x679 0xa801 0x4d1 0x9b5 0xa77c 0x4bf
		0xcf1 0xa702 0x4c4 0x102e 0xa690 0x4c8 0x136a 0xa616 0x4bd 0x16a6 0xa5a9 0x4c7
		0x19e2 0xa532 0x4bf 0x1d1f 0xa4c0 0x4c5 0x205b 0xa455 0x4ce 0x2397 0xa3e2 0x4c5
		0x26d4 0xa376 0x4cb 0x2a10 0xa2ff 0x4bd 0x2d4c 0xa29c 0x4be 0x3089 0xa239 0x4cb
		0x33c5 0xa1c1 0x4bd 0x3701 0xa15e 0x4cb 0x3a3d 0xa0f7 0x4c9 0x3d7a 0xa08d 0x4c4
		0x40b6 0xa02a 0x4cb 0x43f2 0x9fc4 0x4c9 0x472f 0x9f5c 0x4c3 0x4a6b 0x9eff 0x4d1
		0x4da7 0x9e98 0x4c8 0x50e4 0x9e32 0x4c9 0x5420 0x9de0 0x4d8 0x575c 0x9d7e 0x4d4
		0x5a98 0x9d1c 0x4d8 0x5dd5 0x9cc1 0x4e3 0x6111 0x9c64 0x4de 0x644d 0x9c1d 0x4df
		0x678a 0x9bcb 0x4df 0x6ac6 0x9b7f 0x4e3 0x6e02 0x9b26 0x4df 0x713f 0x9ad4 0x4e5
		0x747b 0x9a85 0x4e7 0x77b7 0x9a30 0x4e6 0x7af4 0x99e4 0x4e7 0x7e30 0x99a0 0x4f3
		0x816c 0x993c 0x4e7 0x84a8 0x98e7 0x4e9 0x87e5 0x9889 0x4e5 0x8b21 0x980e 0x4da
		0x8e5d 0x979c 0x4ce 0x919a 0x9745 0x4d1 0x94d6 0x96f2 0x4c1 0x9812 0x96ae 0x4bd
		0x9b4f 0x9677 0x4ca 0x9e8b 0x963f 0x4c4 0xa1c7 0x9611 0x4c6 0xa503 0x95d8 0x4c4
		0xa840 0x95ad 0x4c2 0xab7c 0x957c 0x4c2 0xaeb8 0x954d 0x4ca 0xb1f5 0x9528 0x4cc
		0xb531 0x9509 0x4d1 0xb86d 0x94d8 0x4c6 0xbbaa 0x94ac 0x4c1 0xbee6 0x948b 0x4c5
		0xc222 0x9472 0x4d0 0xc55e 0x944e 0x4d8 0xc89b 0x9429 0x4d8 0xcbd7 0x9412 0x4d8
		0xcf13 0x93f4 0x4da 0xd250 0x93da 0x4d8 0xd58c 0x93b9 0x4da 0xd8c8 0x939f 0x4d4
		0xdc05 0x9381 0x4d7 0xdf41 0x9365 0x4d0 0xe27d 0x9345 0x4dd 0xe5ba 0x930c 0x4d2
		0xe8f6 0x92c1 0x4ce 0xec32 0x9283 0x4c5 0xef6e 0x9259 0x4c5 0xf2ab 0x9232 0x4c8
		0xf5e7 0x9216 0x4d8 0xf923 0x91ed 0x4d8 0xfc60 0x91c6 0x4d5 0xff9c 0x919f 0x4d1
		0x102d8 0x917e 0x4cf 0x10615 0x9153 0x4cd 0x10951 0x9132 0x4d1 0x10c8d 0x90ef 0x4d8
		0x10fc9 0x90b4 0x4da 0x11306 0x907f 0x4d8 0x11642 0x9043 0x4d8 0x1197e 0x8ff9 0x4d3
		0x11cbb 0x8fb0 0x4d2 0x11ff7 0x8fa2 0x4d5 0x12333 0x8fa0 0x4e0 0x12670 0x8f98 0x4eb
		0x129ac 0x8f7f 0x4f3 0x12ce8 0x8f6f 0x503 0x13024 0x8f3f 0x519 0x13361 0x8e68 0x505
		0x1369d 0x8cd1 0x4ee 0x139d9 0x8aca 0x50b 0x13d16 0x8816 0x51b 0x14052 0x843a 0x535
	>;
	battery0_profile_t1_num = <0x64>;
	battery0_profile_t1_col = <0x03>;
	battery0_profile_t1 = <
		0x00 0xa91c 0x398 0x33c 0xa892 0x399 0x679 0xa810 0x3a2 0x9b5 0xa798 0x39b
		0xcf1 0xa722 0x39c 0x102e 0xa6ad 0x3a8 0x136a 0xa639 0x39a 0x16a6 0xa5c7 0x3cb
		0x19e2 0xa554 0x3ab 0x1d1f 0xa4e4 0x379 0x205b 0xa475 0x36c 0x2397 0xa406 0x3a1
		0x26d4 0xa398 0x384 0x2a10 0xa32e 0x382 0x2d4c 0xa2c0 0x3a0 0x3089 0xa256 0x37f
		0x33c5 0xa1eb 0x38c 0x3701 0xa17f 0x393 0x3a3d 0xa112 0x3e9 0x3d7a 0xa0a8 0x3c2
		0x40b6 0xa041 0x3da 0x43f2 0x9fd9 0x3c5 0x472f 0x9f79 0x3c0 0x4a6b 0x9f2d 0x3c6
		0x4da7 0x9ef6 0x3d5 0x50e4 0x9eaa 0x3c9 0x5420 0x9e2f 0x3c1 0x575c 0x9d84 0x3c5
		0x5a98 0x9ce2 0x3dd 0x5dd5 0x9c5f 0x3cd 0x6111 0x9c01 0x3c4 0x644d 0x9bbc 0x3ac
		0x678a 0x9b81 0x3b5 0x6ac6 0x9b51 0x3c9 0x6e02 0x9b0f 0x3e1 0x713f 0x9ac6 0x431
		0x747b 0x9a7a 0x450 0x77b7 0x9a2c 0x411 0x7af4 0x99ce 0x419 0x7e30 0x996c 0x402
		0x816c 0x9903 0x3fa 0x84a8 0x989a 0x3d0 0x87e5 0x9830 0x3bd 0x8b21 0x97ce 0x3e3
		0x8e5d 0x977b 0x3b6 0x919a 0x9731 0x3ae 0x94d6 0x96f4 0x3a3 0x9812 0x96b7 0x3a9
		0x9b4f 0x9680 0x3a7 0x9e8b 0x964c 0x394 0xa1c7 0x9619 0x399 0xa503 0x95eb 0x399
		0xa840 0x95be 0x395 0xab7c 0x9593 0x397 0xaeb8 0x956b 0x395 0xb1f5 0x9543 0x395
		0xb531 0x951d 0x392 0xb86d 0x94fb 0x392 0xbbaa 0x94d7 0x396 0xbee6 0x94b5 0x399
		0xc222 0x9497 0x395 0xc55e 0x9477 0x3a1 0xc89b 0x945c 0x393 0xcbd7 0x943f 0x39b
		0xcf13 0x9424 0x397 0xd250 0x940a 0x395 0xd58c 0x93ee 0x399 0xd8c8 0x93d3 0x39f
		0xdc05 0x93b9 0x39c 0xdf41 0x939c 0x3a1 0xe27d 0x937d 0x39d 0xe5ba 0x9363 0x3ac
		0xe8f6 0x9346 0x3a4 0xec32 0x9326 0x394 0xef6e 0x92fc 0x384 0xf2ab 0x92d4 0x381
		0xf5e7 0x92a8 0x37d 0xf923 0x9288 0x37c 0xfc60 0x9267 0x387 0xff9c 0x9247 0x386
		0x102d8 0x9222 0x390 0x10615 0x91ed 0x384 0x10951 0x91b1 0x37e 0x10c8d 0x9177 0x388
		0x10fc9 0x9140 0x38c 0x11306 0x9107 0x392 0x11642 0x90b6 0x38f 0x1197e 0x9071 0x390
		0x11cbb 0x9059 0x399 0x11ff7 0x9051 0x3a0 0x12333 0x9045 0x3bb 0x12670 0x9033 0x3bc
		0x129ac 0x9021 0x3c8 0x12ce8 0x8ff4 0x406 0x13024 0x8f52 0x431 0x13361 0x8ddc 0x41e
		0x1369d 0x8bd6 0x44f 0x139d9 0x8923 0x484 0x13d16 0x854a 0x4be 0x14052 0x84ac 0x4c9
	>;
	battery0_profile_t2_num = <0x64>;
	battery0_profile_t2_col = <0x03>;
	battery0_profile_t2 = <
		0x00 0xa906 0x9d8 0x33c 0xa85c 0x9d4 0x679 0xa7c5 0x9d8 0x9b5 0xa74b 0x9de
		0xcf1 0xa6c5 0x9e3 0x102e 0xa64a 0x9e0 0x136a 0xa5d8 0x9e5 0x16a6 0xa564 0x9e2
		0x19e2 0xa4fb 0x9e4 0x1d1f 0xa47f 0x9d3 0x205b 0xa416 0x9dc 0x2397 0xa39a 0x9d1
		0x26d4 0xa331 0x9d1 0x2a10 0xa2c9 0x9ce 0x2d4c 0xa25f 0x9d0 0x3089 0xa1e9 0x9c7
		0x33c5 0xa173 0x9bf 0x3701 0xa111 0x9cb 0x3a3d 0xa0a2 0x9bf 0x3d7a 0xa030 0x9b7
		0x40b6 0x9fd4 0x9c2 0x43f2 0x9f78 0x9c6 0x472f 0x9f30 0x9d7 0x4a6b 0x9eef 0x9df
		0x4da7 0x9eac 0x9e6 0x50e4 0x9e2a 0x9e3 0x5420 0x9d6d 0x9ba 0x575c 0x9cb4 0x9ad
		0x5a98 0x9c10 0x992 0x5dd5 0x9ba6 0x9b0 0x6111 0x9b3b 0x9a3 0x644d 0x9af6 0x9a5
		0x678a 0x9ac5 0x9b0 0x6ac6 0x9a94 0x9b0 0x6e02 0x9a6c 0x9bd 0x713f 0x9a25 0x9b0
		0x747b 0x99db 0x99f 0x77b7 0x999d 0x9ad 0x7af4 0x993e 0x9a0 0x7e30 0x98d3 0x989
		0x816c 0x9871 0x97a 0x84a8 0x97fb 0x96c 0x87e5 0x9798 0x955 0x8b21 0x9743 0x950
		0x8e5d 0x96e8 0x94c 0x919a 0x96a6 0x94c 0x94d6 0x966e 0x94c 0x9812 0x962d 0x946
		0x9b4f 0x95f6 0x945 0x9e8b 0x95b7 0x945 0xa1c7 0x958f 0x945 0xa503 0x9567 0x94c
		0xa840 0x9540 0x959 0xab7c 0x9516 0x957 0xaeb8 0x94e8 0x94e 0xb1f5 0x94b6 0x94c
		0xb531 0x9499 0x955 0xb86d 0x947e 0x960 0xbbaa 0x9455 0x954 0xbee6 0x9443 0x964
		0xc222 0x941e 0x967 0xc55e 0x940e 0x97d 0xc89b 0x93e9 0x981 0xcbd7 0x93d6 0x988
		0xcf13 0x93b4 0x988 0xd250 0x93a4 0x991 0xd58c 0x938a 0x98f 0xd8c8 0x9380 0x993
		0xdc05 0x9373 0x9a3 0xdf41 0x9359 0x9a3 0xe27d 0x9352 0x9bb 0xe5ba 0x9342 0x9c6
		0xe8f6 0x9329 0x9d0 0xec32 0x930d 0x9df 0xef6e 0x92e7 0x9b0 0xf2ab 0x92c6 0x9ba
		0xf5e7 0x9297 0x9c1 0xf923 0x927b 0xa01 0xfc60 0x9253 0xa12 0xff9c 0x922c 0x9c3
		0x102d8 0x9204 0x966 0x10615 0x91c3 0x974 0x10951 0x9178 0x972 0x10c8d 0x913f 0x98d
		0x10fc9 0x9104 0x9b7 0x11306 0x90b0 0x9c7 0x11642 0x905e 0x9ed 0x1197e 0x903e 0xa13
		0x11cbb 0x9023 0xa3e 0x11ff7 0x900c 0xa6e 0x12333 0x8ff5 0xaae 0x12670 0x8fd4 0xb0a
		0x129ac 0x8f80 0xb59 0x12ce8 0x8eab 0xba3 0x13024 0x8d14 0xbee 0x13361 0x8ab6 0xc88
		0x1369d 0x8778 0xd48 0x139d9 0x855c 0xdc0 0x13d16 0x855c 0xdc0 0x14052 0x855c 0xdc0
	>;
	battery0_profile_t3_num = <0x64>;
	battery0_profile_t3_col = <0x03>;
	battery0_profile_t3 = <
		0x00 0xa94e 0xd3e 0x33c 0xa889 0xd57 0x679 0xa7ea 0xd65 0x9b5 0xa75b 0xd18
		0xcf1 0xa6d7 0xd64 0x102e 0xa65d 0xd64 0x136a 0xa5e6 0xd61 0x16a6 0xa572 0xd66
		0x19e2 0xa500 0xd5f 0x1d1f 0xa491 0xd14 0x205b 0xa422 0xd44 0x2397 0xa3b6 0xd3b
		0x26d4 0xa34b 0xd3c 0x2a10 0xa2de 0xd3c 0x2d4c 0xa275 0xd37 0x3089 0xa20b 0xcf2
		0x33c5 0xa19e 0xd16 0x3701 0xa134 0xd03 0x3a3d 0xa0c9 0xd04 0x3d7a 0xa064 0xd06
		0x40b6 0xa00a 0xd11 0x43f2 0x9fc0 0xcd8 0x472f 0x9f7a 0xd01 0x4a6b 0x9f30 0xcf2
		0x4da7 0x9ec9 0xcf1 0x50e4 0x9e3b 0xcea 0x5420 0x9d8b 0xcbb 0x575c 0x9cde 0xc76
		0x5a98 0x9c43 0xc82 0x5dd5 0x9bc8 0xc66 0x6111 0x9b62 0xc6c 0x644d 0x9b0c 0xc74
		0x678a 0x9ac5 0xc7b 0x6ac6 0x9a85 0xc41 0x6e02 0x9a44 0xc69 0x713f 0x9a04 0xc57
		0x747b 0x99ba 0xc5e 0x77b7 0x996e 0xc57 0x7af4 0x991c 0xc4f 0x7e30 0x98c9 0xc03
		0x816c 0x986f 0xc1b 0x84a8 0x9817 0xbfd 0x87e5 0x97c4 0xc0d 0x8b21 0x9772 0xc05
		0x8e5d 0x9729 0xc02 0x919a 0x96e6 0xbbb 0x94d6 0x96a5 0xbe0 0x9812 0x966a 0xbc9
		0x9b4f 0x9634 0xbe3 0x9e8b 0x95fe 0xbe8 0xa1c7 0x95ce 0xbe7 0xa503 0x95a0 0xba1
		0xa840 0x9575 0xbd7 0xab7c 0x954b 0xbc9 0xaeb8 0x9523 0xbe7 0xb1f5 0x94fe 0xbec
		0xb531 0x94da 0xbf5 0xb86d 0x94b9 0xbb5 0xbbaa 0x9498 0xbf1 0xbee6 0x9479 0xbe7
		0xc222 0x945b 0xc06 0xc55e 0x9441 0xc0f 0xc89b 0x942a 0xc16 0xcbd7 0x9419 0xbd8
		0xcf13 0x9407 0xc0d 0xd250 0x93f8 0xc0e 0xd58c 0x93ea 0xc38 0xd8c8 0x93de 0xc53
		0xdc05 0x93ce 0xc6a 0xdf41 0x93c0 0xc37 0xe27d 0x93b0 0xc74 0xe5ba 0x939d 0xc77
		0xe8f6 0x938a 0xcb1 0xec32 0x9374 0xcd4 0xef6e 0x935c 0xcf9 0xf2ab 0x9342 0xccf
		0xf5e7 0x9326 0xd10 0xf923 0x9305 0xd1b 0xfc60 0x92e2 0xd5f 0xff9c 0x92b9 0xd92
		0x102d8 0x928b 0xdbf 0x10615 0x9259 0xda8 0x10951 0x9221 0xdfb 0x10c8d 0x91e6 0xe26
		0x10fc9 0x91a8 0xe76 0x11306 0x9162 0xec7 0x11642 0x9117 0xf0f 0x1197e 0x90d5 0xf17
		0x11cbb 0x90a1 0xf81 0x11ff7 0x9079 0xfdc 0x12333 0x9058 0x1069 0x12670 0x9038 0x10ff
		0x129ac 0x900c 0x1194 0x12ce8 0x8fc4 0x11e0 0x13024 0x8f3c 0x1256 0x13361 0x8e41 0x12dd
		0x1369d 0x8cb2 0x1386 0x139d9 0x8a68 0x1458 0x13d16 0x8838 0x1412 0x14052 0x8838 0x1412
	>;
	battery0_profile_t4_num = <0x64>;
	battery0_profile_t4_col = <0x03>;
	battery0_profile_t4 = <
		0x00 0xa926 0x1522 0x33c 0xa843 0x154d 0x679 0xa78b 0x1545 0x9b5 0xa6ef 0x1508
		0xcf1 0xa662 0x148c 0x102e 0xa5db 0x142c 0x136a 0xa55d 0x13f2 0x16a6 0xa4e6 0x13bc
		0x19e2 0xa470 0x1386 0x1d1f 0xa400 0x135b 0x205b 0xa391 0x132d 0x2397 0xa322 0x1305
		0x26d4 0xa2b6 0x12e1 0x2a10 0xa248 0x12bf 0x2d4c 0xa1de 0x1299 0x3089 0xa171 0x1277
		0x33c5 0xa104 0x125f 0x3701 0xa09b 0x1247 0x3a3d 0xa03f 0x1279 0x3d7a 0x9fec 0x126d
		0x40b6 0x9f9d 0x122a 0x43f2 0x9f41 0x1210 0x472f 0x9ed2 0x11f8 0x4a6b 0x9e4b 0x11cc
		0x4da7 0x9da5 0x11a2 0x50e4 0x9cfb 0x1174 0x5420 0x9c5e 0x1153 0x575c 0x9bce 0x1172
		0x5a98 0x9b58 0x114c 0x5dd5 0x9af3 0x1115 0x6111 0x9a99 0x1116 0x644d 0x9a4b 0x110a
		0x678a 0x9a00 0x10fc 0x6ac6 0x99b1 0x10f4 0x6e02 0x9968 0x10e8 0x713f 0x991e 0x10d8
		0x747b 0x98d2 0x10d4 0x77b7 0x9888 0x10bd 0x7af4 0x983c 0x10b3 0x7e30 0x97f4 0x10a3
		0x816c 0x97ab 0x109b 0x84a8 0x9768 0x1097 0x87e5 0x9722 0x108f 0x8b21 0x96e0 0x1089
		0x8e5d 0x96a0 0x108c 0x919a 0x9662 0x1101 0x94d6 0x9629 0x10eb 0x9812 0x95f8 0x10af
		0x9b4f 0x95c5 0x1084 0x9e8b 0x9596 0x1083 0xa1c7 0x9569 0x107e 0xa503 0x953c 0x1082
		0xa840 0x9514 0x1089 0xab7c 0x94ed 0x1086 0xaeb8 0x94ca 0x1094 0xb1f5 0x94a4 0x1091
		0xb531 0x9485 0x1092 0xb86d 0x9468 0x10a1 0xbbaa 0x9452 0x10a2 0xbee6 0x943b 0x10aa
		0xc222 0x9429 0x10b8 0xc55e 0x9416 0x10c3 0xc89b 0x9405 0x10dd 0xcbd7 0x93f4 0x10f3
		0xcf13 0x93e6 0x1108 0xd250 0x93d3 0x111f 0xd58c 0x93c4 0x113d 0xd8c8 0x93b3 0x1186
		0xdc05 0x93a4 0x11e0 0xdf41 0x938f 0x1201 0xe27d 0x937a 0x1228 0xe5ba 0x9363 0x11fe
		0xe8f6 0x934b 0x121e 0xec32 0x932f 0x1256 0xef6e 0x9313 0x127d 0xf2ab 0x92f5 0x12b1
		0xf5e7 0x92d1 0x12e9 0xf923 0x92ac 0x1321 0xfc60 0x9284 0x1357 0xff9c 0x9259 0x1394
		0x102d8 0x922a 0x13c4 0x10615 0x91f7 0x1416 0x10951 0x91bf 0x1463 0x10c8d 0x9183 0x14ca
		0x10fc9 0x9146 0x14da 0x11306 0x910b 0x1526 0x11642 0x90d3 0x1575 0x1197e 0x90a3 0x15cb
		0x11cbb 0x907d 0x162a 0x11ff7 0x905a 0x167f 0x12333 0x9036 0x16cd 0x12670 0x9006 0x172d
		0x129ac 0x8fb7 0x1787 0x12ce8 0x8f2f 0x17d8 0x13024 0x8e46 0x1838 0x13361 0x8cd7 0x16ae
		0x1369d 0x8b4a 0x1717 0x139d9 0x8b4a 0x1717 0x13d16 0x8b4a 0x1717 0x14052 0x8b4a 0x1717
	>;
	battery1_profile_t0_num = <0x64>;
	battery1_profile_t0_col = <0x03>;
	battery1_profile_t0 = <
		0x00 0xa938 0x37a 0x31c 0xa874 0x37a 0x638 0xa7b0 0x37a 0x954 0xa711 0x37a
		0xc6f 0xa685 0x37a 0xf8b 0xa5fe 0x37a 0x12a7 0xa583 0x37a 0x15c3 0xa508 0x37a
		0x18df 0xa495 0x37a 0x1bfb 0xa422 0x37a 0x1f17 0xa3b0 0x37a 0x2232 0xa33e 0x37a
		0x254e 0xa2cd 0x37a 0x286a 0xa263 0x37a 0x2b86 0xa1f8 0x37a 0x2ea2 0xa18b 0x37a
		0x31be 0xa11d 0x37a 0x34da 0xa0b3 0x37a 0x37f5 0xa04d 0x37a 0x3b11 0x9fe7 0x37b
		0x3e2d 0x9f86 0x37f 0x4149 0x9f24 0x383 0x4465 0x9ec3 0x384 0x4781 0x9e62 0x384
		0x4a9d 0x9e04 0x386 0x4db8 0x9daa 0x38a 0x50d4 0x9d51 0x38e 0x53f0 0x9cf8 0x393
		0x570c 0x9c9f 0x397 0x5a28 0x9c49 0x39b 0x5d44 0x9bf4 0x39f 0x6060 0x9ba2 0x3a4
		0x637b 0x9b56 0x3a8 0x6697 0x9b0a 0x3ac 0x69b3 0x9ac2 0x3b5 0x6ccf 0x9a7a 0x3bd
		0x6feb 0x9a34 0x3c5 0x7307 0x99f0 0x3ce 0x7623 0x99ac 0x3d8 0x793e 0x9968 0x3e4
		0x7c5a 0x9925 0x3f1 0x7f76 0x98d9 0x3fa 0x8292 0x988c 0x402 0x85ae 0x982c 0x3f2
		0x88ca 0x97be 0x3d0 0x8be6 0x9755 0x3b0 0x8f01 0x96fc 0x397 0x921d 0x96a3 0x37e
		0x9539 0x9667 0x376 0x9855 0x962f 0x372 0x9b71 0x95fc 0x370 0x9e8d 0x95ce 0x370
		0xa1a9 0x959f 0x370 0xa4c5 0x9571 0x370 0xa7e0 0x9542 0x370 0xaafc 0x951d 0x373
		0xae18 0x94fb 0x378 0xb134 0x94d9 0x37a 0xb450 0x94b7 0x37a 0xb76c 0x9496 0x37a
		0xba88 0x9478 0x37f 0xbda3 0x945a 0x383 0xc0bf 0x9440 0x387 0xc3db 0x9426 0x38b
		0xc6f7 0x940d 0x390 0xca13 0x93f4 0x394 0xcd2f 0x93da 0x398 0xd04b 0x93c5 0x3a0
		0xd366 0x93b0 0x3a9 0xd682 0x9392 0x3a9 0xd99e 0x9370 0x3a5 0xdcba 0x9347 0x39d
		0xdfd6 0x930c 0x38c 0xe2f2 0x92d0 0x37b 0xe60e 0x92a4 0x37a 0xe929 0x927a 0x37a
		0xec45 0x9250 0x37a 0xef61 0x9225 0x37a 0xf27d 0x91fd 0x37b 0xf599 0x91db 0x37f
		0xf8b5 0x91b9 0x383 0xfbd1 0x918c 0x388 0xfeec 0x915d 0x38c 0x10208 0x9128 0x38e
		0x10524 0x90ed 0x38e 0x10840 0x90af 0x38c 0x10b5c 0x9067 0x37f 0x10e78 0x901f 0x373
		0x11194 0x8ff9 0x377 0x114af 0x8fdb 0x37f 0x117cb 0x8fc5 0x394 0x11ae7 0x8fb8 0x3bb
		0x11e03 0x8fa4 0x3df 0x1211f 0x8f36 0x3f0 0x1243b 0x8ec8 0x401 0x12757 0x8d2a 0x3fa
		0x12a72 0x8b12 0x3e9 0x12d8e 0x87ab 0x43f 0x130aa 0x81f6 0x549 0x133c6 0x7c42 0x654
	>;
	battery1_profile_t1_num = <0x64>;
	battery1_profile_t1_col = <0x03>;
	battery1_profile_t1 = <
		0x00 0xa992 0x29e 0x31c 0xa8b6 0x298 0x638 0xa806 0x29e 0x954 0xa76d 0x29e
		0xc6f 0xa6e6 0x29e 0xf8b 0xa661 0x29e 0x12a7 0xa5e9 0x29e 0x15c3 0xa571 0x29e
		0x18df 0xa4fb 0x29e 0x1bfb 0xa486 0x29b 0x1f17 0xa415 0x294 0x2232 0xa3a3 0x2a3
		0x254e 0xa332 0x2a8 0x286a 0xa2c4 0x2a8 0x2b86 0xa256 0x2a8 0x2ea2 0xa1eb 0x2a8
		0x31be 0xa17f 0x2a8 0x34da 0xa113 0x2a8 0x37f5 0xa0ad 0x2af 0x3b11 0xa045 0x2b2
		0x3e2d 0x9fe0 0x2b2 0x4149 0x9f7a 0x2b2 0x4465 0x9f19 0x2b2 0x4781 0x9eb8 0x2b2
		0x4a9d 0x9e59 0x2bc 0x4db8 0x9dfb 0x2bc 0x50d4 0x9d9e 0x2bc 0x53f0 0x9d43 0x2bc
		0x570c 0x9cee 0x2c6 0x5a28 0x9c98 0x2c6 0x5d44 0x9c42 0x2c6 0x6060 0x9bf2 0x2c9
		0x637b 0x9ba3 0x2d0 0x6697 0x9b59 0x2d0 0x69b3 0x9b0c 0x2d0 0x6ccf 0x9ac2 0x2d7
		0x6feb 0x9a7a 0x2da 0x7307 0x9a32 0x2da 0x7623 0x99ea 0x2df 0x793e 0x99a2 0x2e4
		0x7c5a 0x9958 0x2e4 0x7f76 0x9909 0x2e1 0x8292 0x98ab 0x2da 0x85ae 0x9849 0x2d1
		0x88ca 0x97da 0x2bc 0x8be6 0x9773 0x2ac 0x8f01 0x971d 0x2a6 0x921d 0x96d4 0x29e
		0x9539 0x9692 0x29a 0x9855 0x965a 0x294 0x9b71 0x9625 0x294 0x9e8d 0x95f6 0x294
		0xa1a9 0x95c7 0x294 0xa4c5 0x95a1 0x294 0xa7e0 0x9576 0x294 0xaafc 0x9553 0x299
		0xae18 0x952b 0x294 0xb134 0x9509 0x294 0xb450 0x94e9 0x294 0xb76c 0x94c8 0x294
		0xba88 0x94ab 0x29e 0xbda3 0x948f 0x29e 0xc0bf 0x9474 0x29e 0xc3db 0x9459 0x29e
		0xc6f7 0x9441 0x29e 0xca13 0x942a 0x29e 0xcd2f 0x9411 0x29f 0xd04b 0x93fd 0x2a2
		0xd366 0x93e9 0x2a8 0xd682 0x93d5 0x2a8 0xd99e 0x93bd 0x2a4 0xdcba 0x939f 0x29e
		0xdfd6 0x9381 0x29e 0xe2f2 0x9360 0x29e 0xe60e 0x9340 0x29e 0xe929 0x931e 0x29e
		0xec45 0x92fa 0x29e 0xef61 0x92ce 0x294 0xf27d 0x92a8 0x296 0xf599 0x9287 0x29e
		0xf8b5 0x9263 0x29e 0xfbd1 0x9242 0x29e 0xfeec 0x9216 0x29e 0x10208 0x91dc 0x29e
		0x10524 0x919d 0x29e 0x10840 0x9163 0x2a5 0x10b5c 0x9129 0x2a7 0x10e78 0x90dc 0x2a3
		0x11194 0x908b 0x29e 0x114af 0x9065 0x2a5 0x117cb 0x9057 0x2ab 0x11ae7 0x904a 0x2b2
		0x11e03 0x903a 0x2c0 0x1211f 0x9021 0x2c7 0x1243b 0x8fe4 0x2da 0x12757 0x8f13 0x2ce
		0x12a72 0x8d4f 0x2ce 0x12d8e 0x8ae2 0x2e8 0x130aa 0x8793 0x30c 0x133c6 0x8488 0x32a
	>;
	battery1_profile_t2_num = <0x64>;
	battery1_profile_t2_col = <0x03>;
	battery1_profile_t2 = <
		0x00 0xa93d 0x5fa 0x31c 0xa878 0x5fa 0x638 0xa7b4 0x5fa 0x954 0xa715 0x5fa
		0xc6f 0xa68b 0x5fa 0xf8b 0xa606 0x5fa 0x12a7 0xa58b 0x5fa 0x15c3 0xa511 0x5fa
		0x18df 0xa49d 0x5fa 0x1bfb 0xa429 0x5fa 0x1f17 0xa3b6 0x5fa 0x2232 0xa343 0x5fa
		0x254e 0xa2d1 0x5fb 0x286a 0xa263 0x5ff 0x2b86 0xa1f5 0x603 0x2ea2 0xa189 0x608
		0x31be 0xa11c 0x60c 0x34da 0xa0b3 0x610 0x37f5 0xa04d 0x614 0x3b11 0x9fe7 0x619
		0x3e2d 0x9f84 0x622 0x4149 0x9f21 0x62a 0x4465 0x9ebf 0x63a 0x4781 0x9e5c 0x64b
		0x4a9d 0x9df8 0x654 0x4db8 0x9d92 0x654 0x50d4 0x9d2d 0x653 0x53f0 0x9cce 0x64b
		0x570c 0x9c6e 0x642 0x5a28 0x9c17 0x640 0x5d44 0x9bc2 0x640 0x6060 0x9b6c 0x640
		0x637b 0x9b13 0x640 0x6697 0x9ab9 0x640 0x69b3 0x9a5b 0x633 0x6ccf 0x99fd 0x626
		0x6feb 0x999e 0x614 0x7307 0x9940 0x5ff 0x7623 0x98e5 0x5ec 0x793e 0x988e 0x5df
		0x7c5a 0x9838 0x5d3 0x7f76 0x97e7 0x5c6 0x8292 0x9797 0x5b9 0x85ae 0x974c 0x5af
		0x88ca 0x9705 0x5a7 0x8be6 0x96c0 0x59f 0x8f01 0x9684 0x59b 0x921d 0x9647 0x597
		0x9539 0x9612 0x596 0x9855 0x95dd 0x596 0x9b71 0x95ab 0x598 0x9e8d 0x957c 0x59c
		0xa1a9 0x954d 0x5a1 0xa4c5 0x9524 0x5a5 0xa7e0 0x94fc 0x5a9 0xaafc 0x94d4 0x5aa
		0xae18 0x94ac 0x5aa 0xb134 0x9487 0x5aa 0xb450 0x9463 0x5aa 0xb76c 0x9440 0x5aa
		0xba88 0x9423 0x5af 0xbda3 0x9406 0x5b3 0xc0bf 0x93ef 0x5ba 0xc3db 0x93da 0x5c3
		0xc6f7 0x93c7 0x5cf 0xca13 0x93b7 0x5e0 0xcd2f 0x93a7 0x5f1 0xd04b 0x9398 0x606
		0xd366 0x9388 0x61b 0xd682 0x9376 0x639 0xd99e 0x9362 0x65b 0xdcba 0x934e 0x67d
		0xdfd6 0x9337 0x69f 0xe2f2 0x9321 0x6c1 0xe60e 0x9304 0x6ef 0xe929 0x92e8 0x71d
		0xec45 0x92c7 0x74e 0xef61 0x92a5 0x782 0xf27d 0x9280 0x7b6 0xf599 0x9251 0x7ed
		0xf8b5 0x9223 0x824 0xfbd1 0x91ed 0x866 0xfeec 0x91b6 0x8aa 0x10208 0x9178 0x8f3
		0x10524 0x9135 0x93f 0x10840 0x90f2 0x991 0x10b5c 0x90ab 0xa00 0x10e78 0x9064 0xa6e
		0x11194 0x9027 0xb18 0x114af 0x8fed 0xbce 0x117cb 0x8fb8 0xcd3 0x11ae7 0x8f89 0xe34
		0x11e03 0x8f51 0xfce 0x1211f 0x8ed1 0x1329 0x1243b 0x8e52 0x1685 0x12757 0x8d3b 0x17bf
		0x12a72 0x8b44 0x1612 0x12d8e 0x884a 0x131e 0x130aa 0x871c 0x11f8 0x133c6 0x871c 0x11f8
	>;
	battery1_profile_t3_num = <0x64>;
	battery1_profile_t3_col = <0x03>;
	battery1_profile_t3 = <
		0x00 0xa979 0x672 0x31c 0xa870 0x672 0x638 0xa7b2 0x670 0x954 0xa719 0x668
		0xc6f 0xa68f 0x668 0xf8b 0xa60c 0x65e 0x12a7 0xa591 0x654 0x15c3 0xa518 0x653
		0x18df 0xa4a2 0x64a 0x1bfb 0xa42f 0x647 0x1f17 0xa3bc 0x640 0x2232 0xa34b 0x640
		0x254e 0xa2db 0x636 0x286a 0xa26d 0x636 0x2b86 0xa202 0x636 0x2ea2 0xa195 0x62d
		0x31be 0xa129 0x62c 0x34da 0xa0bf 0x62c 0x37f5 0xa055 0x628 0x3b11 0x9fee 0x622
		0x3e2d 0x9f8b 0x622 0x4149 0x9f2d 0x62c 0x4465 0x9ec9 0x62c 0x4781 0x9e62 0x62c
		0x4a9d 0x9df6 0x62c 0x4db8 0x9d89 0x62c 0x50d4 0x9d20 0x622 0x53f0 0x9cb7 0x622
		0x570c 0x9c52 0x613 0x5a28 0x9bf2 0x60e 0x5d44 0x9b94 0x607 0x6060 0x9b41 0x604
		0x637b 0x9aee 0x5fb 0x6697 0x9a95 0x5fa 0x69b3 0x9a3a 0x5f0 0x6ccf 0x99dc 0x5e9
		0x6feb 0x9981 0x5e6 0x7307 0x9924 0x5e6 0x7623 0x98ca 0x5d8 0x793e 0x9875 0x5d2
		0x7c5a 0x9823 0x5d2 0x7f76 0x97d2 0x5d0 0x8292 0x9786 0x5c8 0x85ae 0x973d 0x5c8
		0x88ca 0x96fa 0x5c8 0x8be6 0x96b7 0x5c3 0x8f01 0x967b 0x5c8 0x921d 0x9640 0x5c8
		0x9539 0x9609 0x5cb 0x9855 0x95d5 0x5d2 0x9b71 0x95a3 0x5d7 0x9e8d 0x9574 0x5dd
		0xa1a9 0x9548 0x5ed 0xa4c5 0x951b 0x5f0 0xa7e0 0x94f2 0x5f9 0xaafc 0x94cb 0x5fa
		0xae18 0x94a6 0x604 0xb134 0x9483 0x604 0xb450 0x9461 0x606 0xb76c 0x9440 0x616
		0xba88 0x9421 0x61c 0xbda3 0x9408 0x622 0xc0bf 0x93f1 0x62c 0xc3db 0x93de 0x638
		0xc6f7 0x93cf 0x640 0xca13 0x93bf 0x651 0xcd2f 0x93b0 0x667 0xd04b 0x939f 0x677
		0xd366 0x938d 0x688 0xd682 0x937b 0x6a8 0xd99e 0x9364 0x6be 0xdcba 0x9351 0x6dd
		0xdfd6 0x9338 0x6fd 0xe2f2 0x931f 0x728 0xe60e 0x9303 0x757 0xe929 0x92e3 0x787
		0xec45 0x92c1 0x7b7 0xef61 0x92a0 0x7eb 0xf27d 0x927b 0x82a 0xf599 0x924f 0x860
		0xf8b5 0x9222 0x89f 0xfbd1 0x91ee 0x8df 0xfeec 0x91b8 0x928 0x10208 0x917b 0x972
		0x10524 0x913d 0x9cb 0x10840 0x90fb 0xa30 0x10b5c 0x90b3 0xa9e 0x10e78 0x906d 0xb21
		0x11194 0x9029 0xbc2 0x114af 0x8fed 0xc80 0x117cb 0x8fb7 0xd7f 0x11ae7 0x8f7f 0xed1
		0x11e03 0x8f3d 0x1093 0x1211f 0x8e9f 0x12c3 0x1243b 0x8e8b 0x12fc 0x12757 0x8e8b 0x12fc
		0x12a72 0x8e8b 0x12fc 0x12d8e 0x8e8b 0x12fc 0x130aa 0x8e8b 0x12fc 0x133c6 0x8e8b 0x12fc
	>;
	battery1_profile_t4_num = <0x64>;
	battery1_profile_t4_col = <0x03>;
	battery1_profile_t4 = <
		0x00 0xa91a 0xf96 0x31c 0xa7f3 0xf9c 0x638 0xa726 0xf94 0x954 0xa67e 0xf7c
		0xc6f 0xa5e3 0xf6a 0xf8b 0xa55d 0xf51 0x12a7 0xa4d8 0xf36 0x15c3 0xa455 0xf27
		0x18df 0xa3dd 0xf0f 0x1bfb 0xa36a 0xefd 0x1f17 0xa2f4 0xeed 0x2232 0xa284 0xed3
		0x254e 0xa214 0xec3 0x286a 0xa1a2 0xeb3 0x2b86 0xa136 0xea3 0x2ea2 0xa0c7 0xe8a
		0x31be 0xa057 0xe79 0x34da 0x9ff2 0xe69 0x37f5 0x9f93 0xe67 0x3b11 0x9f29 0xe5e
		0x3e2d 0x9ec2 0xe56 0x4149 0x9e4e 0xe48 0x4465 0x9dd9 0xe2e 0x4781 0x9d5f 0xe1e
		0x4a9d 0x9ce6 0xe04 0x4db8 0x9c76 0xdf4 0x50d4 0x9c0b 0xdda 0x53f0 0x9bab 0xdca
		0x570c 0x9b4c 0xdc0 0x5a28 0x9aee 0xdac 0x5d44 0x9a9e 0xda4 0x6060 0x9a4b 0xd9f
		0x637b 0x99ec 0xd8f 0x6697 0x9996 0xd89 0x69b3 0x9942 0xd7b 0x6ccf 0x98eb 0xd76
		0x6feb 0x9899 0xd77 0x7307 0x9849 0xd70 0x7623 0x97fa 0xd75 0x793e 0x97b4 0xd7a
		0x7c5a 0x976b 0xd7a 0x7f76 0x9722 0xd7d 0x8292 0x96e2 0xd84 0x85ae 0x96a2 0xd8d
		0x88ca 0x966d 0xd8e 0x8be6 0x9633 0xd9e 0x8f01 0x95f9 0xda4 0x921d 0x95c2 0xdb4
		0x9539 0x9590 0xdc0 0x9855 0x9560 0xdd4 0x9b71 0x9530 0xdda 0x9e8d 0x9502 0xdea
		0xa1a9 0x94db 0xdfa 0xa4c5 0x94af 0xe07 0xa7e0 0x9485 0xe1a 0xaafc 0x9465 0xe25
		0xae18 0x9447 0xe32 0xb134 0x942f 0xe53 0xb450 0x9413 0xe6a 0xb76c 0x9403 0xe87
		0xba88 0x93f3 0xeb0 0xbda3 0x93d9 0xed1 0xc0bf 0x93c9 0xf07 0xc3db 0x93b6 0xf44
		0xc6f7 0x939f 0xf7d 0xca13 0x938b 0xfcb 0xcd2f 0x936b 0x101a 0xd04b 0x9355 0x1067
		0xd366 0x933f 0x10cb 0xd682 0x931f 0x114a 0xd99e 0x9300 0x11b1 0xdcba 0x92e0 0x122b
		0xdfd6 0x92ca 0x12ba 0xe2f2 0x92a0 0x134c 0xe60e 0x9280 0x13eb 0xe929 0x9260 0x1498
		0xec45 0x9237 0x1547 0xef61 0x9211 0x15fa 0xf27d 0x91e3 0x16ba 0xf599 0x91bc 0x1788
		0xf8b5 0x918c 0x185d 0xfbd1 0x915c 0x193c 0xfeec 0x912c 0x1a16 0x10208 0x90fb 0x1b06
		0x10524 0x90d8 0x1b94 0x10840 0x90d8 0x1b94 0x10b5c 0x90d8 0x1b94 0x10e78 0x90d8 0x1b94
		0x11194 0x90d8 0x1b94 0x114af 0x90d8 0x1b94 0x117cb 0x90d8 0x1b94 0x11ae7 0x90d8 0x1b94
		0x11e03 0x90d8 0x1b94 0x1211f 0x90d8 0x1b94 0x1243b 0x90d8 0x1b94 0x12757 0x90d8 0x1b94
		0x12a72 0x90d8 0x1b94 0x12d8e 0x90d8 0x1b94 0x130aa 0x90d8 0x1b94 0x133c6 0x90d8 0x1b94
	>;
};
